## esp32/sdkconfig.defaults
```kconfig
CONFIG_ESPTOOLPY_FLASHSIZE_2MB=y
CONFIG_ESPTOOLPY_FLASHSIZE="2MB"

CONFIG_BT_ENABLED=y
CONFIG_BT_NIMBLE_ENABLED=y
CONFIG_BT_BLUEDROID_ENABLED=n

# Leave all roles at their default values (y). IDF has a subtle dep that turns
# off ROLE_CENTRAL if any sibling role is explicitly =n, which then drops
# ble_sm_alg.c from the build while ble_hs_resolv.c still references its
# symbols. Accepting default roles avoids the link error.

CONFIG_BT_NIMBLE_HOST_TASK_STACK_SIZE=4096
```
